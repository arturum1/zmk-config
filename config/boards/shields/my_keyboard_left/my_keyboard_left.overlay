#include "my_keyboard.dtsi"

/ {
    kscan0: kscan_he {
        compatible = "he,kscan-multiplexer";
        label = "KSCAN_HE_LEFT";

        select-gpios = <&gpio0 22 GPIO_ACTIVE_HIGH>,  /* D4 */
                       <&gpio0 24 GPIO_ACTIVE_HIGH>,  /* D5 */
                       <&gpio1 0 GPIO_ACTIVE_HIGH>,   /* D6 */
                       <&gpio0 11 GPIO_ACTIVE_HIGH>;  /* D7 */

        /* A1=AIN1, A2=AIN2, A3=AIN4 */
        adc-channels = <&adc 4>, <&adc 2>, <&adc 1>;
        channel-count = <16>;

        v-min = <2146>;
        v-max = <2978>;
        adc-resolution = <12>;
        sample-period-us = <1000>;
    };

    chosen {
        zmk,kscan = &kscan0;
    };
};
