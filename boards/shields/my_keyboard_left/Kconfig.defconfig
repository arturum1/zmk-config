## boards/shields/my_keyboard_left/Kconfig.defconfig
```kconfig
# Left half configuration - typically set as peripheral
if SHIELD_MY_KEYBOARD_LEFT

config ZMK_SPLIT_ROLE_CENTRAL
    default n

endif
```

## boards/shields/my_keyboard_left/Kconfig.shield
```kconfig
# Left split half shield configuration
config SHIELD_MY_KEYBOARD_LEFT
    def_bool $(shields_list_contains,my_keyboard_left)
```

## boards/shields/my_keyboard_right/Kconfig.defconfig
```kconfig
# Right half configuration - typically set as central
if SHIELD_MY_KEYBOARD_RIGHT

config ZMK_SPLIT_ROLE_CENTRAL
    default y

endif
```

## boards/shields/my_keyboard_right/Kconfig.shield
```kconfig
# Right split half shield configuration
config SHIELD_MY_KEYBOARD_RIGHT
    def_bool $(shields_list_contains,my_keyboard_right)
```

## west.yml
```yaml
manifest:
  defaults:
    revision: v0.3
  remotes:
    - name: zmkfirmware
      url-base: https://github.com/zmkfirmware
    # Added for Hall Effect driver support (multiplexer, adjustable actuation)
    - name: he-module
      url-base: https://github.com/cr3eperall
    # Additional modules containing boards/shields/custom code can be listed here as well
    # See https://docs.zephyrproject.org/3.2.0/develop/west/manifest.html#projects
  projects:
    - name: zmk
      remote: zmkfirmware
      import: app/west.yml
    # Hall Effect module: provides he,kscan-multiplexer driver and HE behaviors
    - name: zmk-feature-hall-effect
      remote: he-module
      revision: main  # Stable branch with HE multiplexer support
  self:
    path: .
```
